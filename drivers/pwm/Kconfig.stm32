## drivers/pwm/Kconfig.stm32
```kconfig
# STM32 PWM configuration options

# Copyright (c) 2016 Linaro Limited.
# Copyright (c) 2024 Fabian Pflug
# SPDX-License-Identifier: Apache-2.0

config PWM_STM32
	bool "STM32 MCU PWM driver"
	default y
	depends on DT_HAS_ST_STM32_PWM_ENABLED
	select USE_STM32_LL_TIM
	select USE_STM32_LL_RCC if SOC_SERIES_STM32F4X || SOC_SERIES_STM32F7X || SOC_SERIES_STM32H7X
	select RESET
	help
	  This option enables the PWM driver for STM32 family of
	  processors. Say y if you wish to use PWM port on STM32
	  MCU.

if PWM_STM32

config PWM_STM32_DMA
	bool "STM32 MCU PWM DMA Support"
	select DMA
	help
	  Enable the PWM DMA mode for PWM instances
	  that enable dma channels in their device tree node.

endif
```
